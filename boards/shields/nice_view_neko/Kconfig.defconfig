## boards/shields/nice_view_neko/Kconfig.defconfig
```kconfig
if SHIELD_NICE_VIEW_NEKO

config LV_Z_VDB_SIZE
    default 100

config LV_DPI_DEF
    default 161

config LV_Z_BITS_PER_PIXEL
    default 1

choice LV_COLOR_DEPTH
    default LV_COLOR_DEPTH_1
endchoice

choice ZMK_DISPLAY_WORK_QUEUE
    default ZMK_DISPLAY_WORK_QUEUE_DEDICATED
endchoice

choice ZMK_DISPLAY_STATUS_SCREEN
    default ZMK_DISPLAY_STATUS_SCREEN_CUSTOM
endchoice

config LV_Z_MEM_POOL_SIZE
    default 8192 if ZMK_DISPLAY_STATUS_SCREEN_CUSTOM

config ZMK_DISPLAY_STATUS_SCREEN_CUSTOM
    imply NICE_VIEW_WIDGET_STATUS

config NICE_VIEW_NEKO_FRAME_MS
    int "Pet animation frame duration in milliseconds"
    default 200

config NICE_VIEW_NEKO_WPM_LOW
    int "WPM at or below which the pet idles"
    default 10

config NICE_VIEW_NEKO_WPM_HIGH
    int "WPM above which the pet runs (walks in between)"
    default 40

config NICE_VIEW_NEKO_JUMP
    bool "Pet jumps when space is pressed while typing"
    default y

config NICE_VIEW_NEKO_SCROLL_TIMEOUT_MS
    int "How long the pet keeps chasing after the last encoder tick"
    default 2000

config NICE_VIEW_WIDGET_STATUS
    select LV_USE_LABEL
    select LV_USE_IMAGE
    select LV_USE_CANVAS

config NICE_VIEW_WIDGET_INVERTED
    bool "Invert display colors"

if !ZMK_SPLIT || ZMK_SPLIT_ROLE_CENTRAL

config NICE_VIEW_WIDGET_STATUS
    select ZMK_WPM
    imply ZMK_HID_INDICATORS

endif # !ZMK_SPLIT || ZMK_SPLIT_ROLE_CENTRAL

endif # SHIELD_NICE_VIEW_NEKO
```

## boards/shields/nice_view_neko/Kconfig.shield
```kconfig
config SHIELD_NICE_VIEW_NEKO
    def_bool $(shields_list_contains,nice_view_neko)
```

## dts/bindings/behaviors/zmk,behavior-pet-relay.yaml
```yaml
description: Neko pet state relay (central to peripheral)

compatible: "zmk,behavior-pet-relay"

include: two_param.yaml
```
